## samples/Kconfig
```kconfig
menuconfig SAMPLES
	bool "Sample kernel code"
	help
	  You can build and test sample kernel code here.

if SAMPLES

config SAMPLE_HELLO
	tristate "Build hello world example -- loadable modules only"
	depends on m
	help
	  This builds a simple hello world kernel module example.

config SAMPLE_DUMP_GDT
	tristate "dump arch x86 gdt"
	depends on m
	depends on X86 || x86_64
	help
	  Dump x86 global descriptor table.

endif # SAMPLES
```

## samples/locking/Kconfig
```kconfig
# SPDX-License-Identifier: GPL-2.0-only

config SAMPLE_SEQLOCK
	tristate "Build seqlock examples -- loadable modules only"
	depends on m
	help
	  This config option will allow you to build seqlock
	  example modules showing how to use the seqlock API.

	  If in doubt, say "N" here.
```
